## sdkconfig.defaults
```kconfig
CONFIG_ESPTOOLPY_FLASHSIZE_4MB=y
CONFIG_ESPTOOLPY_FLASHSIZE="4MB"

CONFIG_ESP_CONSOLE_USB_SERIAL_JTAG=y
CONFIG_ESP_CONSOLE_UART_DEFAULT=n
CONFIG_ESP_CONSOLE_SECONDARY_NONE=y

CONFIG_ESP_MAIN_TASK_STACK_SIZE=12288

# V0.6 is a single factory-app build. OTA rollback is intentionally disabled.
# CONFIG_BOOTLOADER_APP_ROLLBACK_ENABLE is not set


# V0.5 SOCIAL - NimBLE BLE observer + broadcaster only.
CONFIG_BT_ENABLED=y
CONFIG_BT_NIMBLE_ENABLED=y
CONFIG_BT_NIMBLE_ROLE_OBSERVER=y
CONFIG_BT_NIMBLE_ROLE_BROADCASTER=y
# CONFIG_BT_NIMBLE_ROLE_CENTRAL is not set
# CONFIG_BT_NIMBLE_ROLE_PERIPHERAL is not set
CONFIG_BT_NIMBLE_MAX_CONNECTIONS=1
CONFIG_BT_NIMBLE_MAX_BONDS=1
CONFIG_BT_NIMBLE_MAX_CCCDS=1
CONFIG_BT_NIMBLE_GATT_MAX_PROCS=1
# CONFIG_BT_NIMBLE_SECURITY_ENABLE is not set
# CONFIG_BT_NIMBLE_SM_SC is not set
CONFIG_BT_LE_SLEEP_ENABLE=y
CONFIG_BT_LE_LP_CLK_SRC_DEFAULT=y
CONFIG_ESP_COEX_SW_COEXIST_ENABLE=y
```
